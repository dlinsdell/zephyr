## drivers/sensor/icm42605/Kconfig
```kconfig
# ICM42605 Six-Axis Motion Tracking device configuration options

# Copyright (c) 2020 TDK Invensense
# SPDX-License-Identifier: Apache-2.0

menuconfig ICM42605
	bool "ICM42605 Six-Axis Motion Tracking Device"
	default y
	depends on DT_HAS_INVENSENSE_ICM42605_ENABLED
	select I2C if $(dt_compat_on_bus,$(DT_COMPAT_INVENSENSE_ICM42605),i2c)
	select SPI if $(dt_compat_on_bus,$(DT_COMPAT_INVENSENSE_ICM42605),spi)
	help
	  Enable driver for ICM42605 I2C/SPI six-axis motion tracking device.

if ICM42605

choice ICM42605_TRIGGER_MODE
	prompt "Trigger mode"
	default ICM42605_TRIGGER_GLOBAL_THREAD
	help
	  Specify the type of triggering to be used by the driver.

config ICM42605_TRIGGER_NONE
	bool "No trigger"

config ICM42605_TRIGGER_GLOBAL_THREAD
	bool "Use global thread"
	depends on GPIO
	select ICM42605_TRIGGER

endchoice

config ICM42605_TRIGGER
	bool

config ICM42605_THREAD_PRIORITY
	int "Thread priority"
	depends on ICM42605_TRIGGER_GLOBAL_THREAD
	default 10
	help
	  Priority of thread used by the driver to handle interrupts.

config ICM42605_THREAD_STACK_SIZE
	int "Thread stack size"
	depends on ICM42605_TRIGGER_GLOBAL_THREAD
	default 1024
	help
	  Stack size of thread used by the driver to handle interrupts.

endif # ICM42605
```

## dts/bindings/sensor/invensense,icm42605-i2c.yaml
```yaml
# Copyright (c) 2020 TDK Invensense
# SPDX-License-Identifier: Apache-2.0

description: ICM-42605 motion tracking device

compatible: "invensense,icm42605"

include: ["invensense,icm42605-common.yaml", "i2c-device.yaml"]

properties:
  int-gpios:
    type: phandle-array
    required: true
    description: |
      The INT signal default configuration is active-high.  The
      property value should ensure the flags properly describe the
      signal that is presented to the driver.
```

## dts/bindings/sensor/invensense,icm42605-spi.yaml
```yaml
# Copyright (c) 2020 TDK Invensense
# SPDX-License-Identifier: Apache-2.0

description: ICM-42605 motion tracking device

# ICM-42605 is SPI.
compatible: "invensense,icm42605"

include: ["invensense,icm42605-common.yaml", "spi-device.yaml"]

properties:
  int-gpios:
    type: phandle-array
    required: true
    description: |
      The INT signal default configuration is active-high.  The
      property value should ensure the flags properly describe the
      signal that is presented to the driver.
```
